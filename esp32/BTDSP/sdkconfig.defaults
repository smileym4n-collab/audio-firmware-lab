## esp32/BTDSP/sdkconfig.defaults
```kconfig
CONFIG_BT_ENABLED=y
CONFIG_BT_CLASSIC_ENABLED=y
CONFIG_BT_A2DP_ENABLE=y
CONFIG_BT_AVRCP_ENABLE=y
CONFIG_BT_BLUEDROID_ENABLED=y
CONFIG_BT_SSP_ENABLED=y
```
